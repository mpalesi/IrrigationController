## firmware/main/Kconfig.projbuild
```kconfig
menu "IrrigationController configuration"

choice IRRIGATION_TARGET
    prompt "Board composition"
    default IRRIGATION_TARGET_DEV_KIT
    help
        Selects the HAL and board composition only. Application and domain code
        remain identical for every target.

config IRRIGATION_TARGET_DEV_KIT
    bool "DEV_KIT (Freenove FNK0090 ESP32-WROOM board)"

config IRRIGATION_TARGET_IRRIGATION_CONTROLLER
    bool "IRRIGATION_CONTROLLER (custom PCB placeholder)"

endchoice

config IRRIGATION_WIFI_SSID
    string "DEV_KIT Wi-Fi SSID"
    default ""

config IRRIGATION_WIFI_PASSWORD
    string "DEV_KIT Wi-Fi password"
    default ""

if IRRIGATION_TARGET_IRRIGATION_CONTROLLER

config IRRIGATION_SHELLY_MASTER_VALVE_HOST
    string "Shelly master-valve hostname or IP"
    default ""

config IRRIGATION_SHELLY_MASTER_VALVE_PORT
    int "Shelly master-valve HTTP port"
    range 1 65535
    default 80

config IRRIGATION_SHELLY_MASTER_VALVE_SWITCH_ID
    int "Shelly master-valve switch ID"
    range 0 255
    default 0

config IRRIGATION_SHELLY_MASTER_VALVE_OPERATION_TIMEOUT_MS
    int "Shelly master-valve operation timeout (ms)"
    range 100 30000
    default 3000

endif

endmenu
```

## firmware/sdkconfig.defaults
```kconfig
CONFIG_IRRIGATION_TARGET_DEV_KIT=y
# CONFIG_IRRIGATION_TARGET_IRRIGATION_CONTROLLER is not set
CONFIG_PARTITION_TABLE_CUSTOM=y
CONFIG_PARTITION_TABLE_CUSTOM_FILENAME="partitions.csv"
```
